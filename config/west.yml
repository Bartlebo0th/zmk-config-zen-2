## config/west.yml
```yaml
manifest:
  remotes:
    - name: zmkfirmware
      url-base: https://github.com/zmkfirmware
  projects:
    - name: zmk
      remote: zmkfirmware
      revision: v0.4
      import: app/west.yml
  self:
    path: config

# manifest:
#   remotes:
#     - name: caksoylar
#       url-base: https://github.com/caksoylar
#   projects:
#     - name: zmk
#       remote: caksoylar
#       revision: caksoylar/zen-v1+v2  # custom branch name
#       import: app/west.yml
#   self:
#     path: config
```
